/ {
    chosen {
        zmk,kscan = &kscan0;
        zmk,matrix_transform = &default_transform; // This restores the split mapping!
    };

    kscan0: kscan_0 {
        compatible = "zmk,kscan-gpio-matrix";
        diode-direction = "col2row";
        
        col-gpios
            = <&gpio0 9  GPIO_ACTIVE_HIGH> 
            , <&gpio0 24 GPIO_ACTIVE_HIGH> 
            , <&gpio1 0  GPIO_ACTIVE_HIGH> 
            , <&gpio0 22 GPIO_ACTIVE_HIGH> 
            , <&gpio1 4  GPIO_ACTIVE_HIGH> 
            , <&gpio1 6  GPIO_ACTIVE_HIGH> 
            ;

        // Reverted to your original, physically correct order
        row-gpios
            = <&gpio0 6  (GPIO_ACTIVE_HIGH | GPIO_PULL_DOWN)> 
            , <&gpio0 8  (GPIO_ACTIVE_HIGH | GPIO_PULL_DOWN)> 
            , <&gpio0 17 (GPIO_ACTIVE_HIGH | GPIO_PULL_DOWN)> 
            , <&gpio0 20 (GPIO_ACTIVE_HIGH | GPIO_PULL_DOWN)> 
            ;
    };
};
