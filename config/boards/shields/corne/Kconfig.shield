## config/boards/shields/corne/Kconfig.shield
```kconfig
config SHIELD_CUSTOM_BOARD_LEFT
    def_bool $(shields_list_contains,custom_board_left)

config SHIELD_CUSTOM_BOARD_RIGHT
    def_bool $(shields_list_contains,custom_board_right)
```

## config/boards/shields/mykeeb/Kconfig.defconfig
```kconfig
if SHIELD_MYKEEB_LEFT

config ZMK_KEYBOARD_NAME
	default "myKeb"

config ZMK_SPLIT_ROLE_CENTRAL
	default y

endif

if SHIELD_MYKEEB_LEFT || SHIELD_MYKEEB_RIGHT

config ZMK_SPLIT
	default y

endif
```
